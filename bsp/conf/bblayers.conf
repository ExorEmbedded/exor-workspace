## bsp/conf/bblayers.conf
```bitbake
LCONF_VERSION = "6"

BBPATH = "${TOPDIR}"

BBFILES ?= ""

SRCDIR ?= "${TOPDIR}/../git"

BBLAYERS = ""
BBLAYERS += "${SRCDIR}/poky/meta"
BBLAYERS += "${SRCDIR}/poky/meta-poky"
BBLAYERS += "${SRCDIR}/poky/meta-yocto-bsp"
BBLAYERS += "${SRCDIR}/meta-openembedded/meta-oe"
BBLAYERS += "${SRCDIR}/meta-openembedded/meta-networking"
BBLAYERS += "${SRCDIR}/meta-openembedded/meta-webserver"
BBLAYERS += "${SRCDIR}/meta-openembedded/meta-gnome"
BBLAYERS += "${SRCDIR}/meta-openembedded/meta-python"
BBLAYERS += "${SRCDIR}/meta-openembedded/meta-multimedia"
BBLAYERS += "${SRCDIR}/meta-freescale"
BBLAYERS += "${SRCDIR}/meta-exorint"
BBLAYERS += "${SRCDIR}/meta-exorint-enterprise"
BBLAYERS += "${SRCDIR}/meta-branding-exorint"
BBLAYERS += "${SRCDIR}/meta-jml"

BBLAYERS_NON_REMOVABLE = "${TOPDIR}/../poky/meta"
BBLAYERS_NON_REMOVABLE += "${TOPDIR}/../poky/meta-yocto"
```

## meta-branding-exorint/conf/layer.conf
```bitbake
BBPATH .= ":${LAYERDIR}"

BBFILES += "${LAYERDIR}/recipes*/*/*.bb"
BBFILES += "${LAYERDIR}/recipes*/*/*.bbappend"

BBFILE_COLLECTIONS += "meta-branding-exorint"
BBFILE_PATTERN_meta-branding-exorint := "^${LAYERDIR}/"
BBFILE_PRIORITY_meta-branding-exorint = "10"
```

## meta-exorint-enterprise/conf/distro/exorintos.conf
```bitbake
require conf/distro/poky.conf

DISTRO = "exorintos"

DISTRO_NAME = "ExorintOS"

# Note: unused (for Exorint versioning see *version.inc files)
DISTRO_VERSION = "0.0.1"

DISTRO_CODENAME = "exorintos"

DISTRO_FEATURES_append = " pam opengl x11"
DISTRO_FEATURES_remove = " 3g bluetooth irda pci pcmcia nfc wayland gobject-introspection-data \
	smbfs alsa pulseaudio ptest bluez5 usbgadget nfs wifi multiarch vulkan"
```

## meta-exorint-enterprise/conf/machine/beaglebone.conf
```bitbake
#@TYPE: Machine
#@NAME: BeagleBone machine
#@DESCRIPTION: Machine configuration for the http://beagleboard.org/bone board 

require conf/machine/include/tune-cortexa8.inc

# Make sure hard fp is enabled (-mfloat-abi=hard GCC option)
DEFAULTTUNE = "cortexa8hf-neon"

IMAGE_FSTYPES += "tar.gz"

MKUBIFS_ARGS = "-F -m 2048 -e 126976 -c 4095"
UBINIZE_ARGS = "-m 2048 -p 128KiB -s 512 -O 2048"
UBI_VOLNAME = "rootfs"

SERIAL_CONSOLE = "115200 ttyO0"

PREFERRED_PROVIDER_virtual/kernel = "linux"

UBOOT_MACHINE = "am335x_evm_config"
KERNEL_MACHINE = "am33xxusom"
```

## meta-exorint-enterprise/conf/machine/include/exor.inc
```bitbake
IMAGE_FSTYPES += "tar.gz"

MKUBIFS_ARGS = "-F -m 2048 -e 126976 -c 4095"
UBINIZE_ARGS = "-m 2048 -p 128KiB -s 512 -O 2048"
UBI_VOLNAME = "rootfs"

MACHINE_FEATURES = "serial rtc fastboot"
```

## meta-exorint-enterprise/conf/machine/include/nsom01.inc
```bitbake
#@TYPE: Machine

require exor.inc
require conf/machine/include/tune-cortexa7.inc

# Make sure hard fp is enabled (-mfloat-abi=hard GCC option)
DEFAULTTUNE = "cortexa7hf-neon"

SERIAL_DEV = "ttymxc"

SERIAL_CONSOLE = "115200 ${SERIAL_DEV}0"

MACHINEOVERRIDES =. "nsom01:"
```

## meta-exorint-enterprise/conf/machine/include/usom01.inc
```bitbake
#@TYPE: Machine

require conf/machine/include/tune-cortexa8.inc
require exor.inc

# Make sure hard fp is enabled (-mfloat-abi=hard GCC option)
DEFAULTTUNE = "cortexa8hf-neon"

SERIAL_DEV = "ttyO"

SERIAL_CONSOLE = "115200 ${SERIAL_DEV}0"

MACHINEOVERRIDES =. "usom01:"
```

## meta-exorint-enterprise/conf/machine/include/usom02.inc
```bitbake
#@TYPE: Machine

require exor.inc
require conf/machine/include/tune-cortexa8.inc

# Make sure hard fp is enabled (-mfloat-abi=hard GCC option)
# Note that the machine has a cortex-A9 processor. However optimizations for a9 should't have a big impact,
# to avoid having different binaries between uSOM01 and uSOM02 we are compiling for a8 for now.
DEFAULTTUNE = "cortexa8hf-neon"

SERIAL_DEV = "ttyS"

SERIAL_CONSOLE = "115200 ${SERIAL_DEV}0"

MACHINEOVERRIDES =. "usom02:"
```

## meta-exorint-enterprise/conf/machine/include/usom03.inc
```bitbake
#@TYPE: Machine

require conf/machine/include/imx-base.inc
require conf/machine/include/tune-cortexa9.inc
require conf/machine/include/soc-family.inc
require exor.inc

# Identify the machine as imx6q also for the dual lite. Differencies
# are only in uboot and kernel, we will deal with these in another way
SOC_FAMILY = "mx6:mx6q:"

# Make sure we install both imx6q and imx6d firmware
MACHINE_FIRMWARE_append = " firmware-imx-vpu-imx6d firmware-imx-epdc"

SERIAL_DEV = "ttymxc"

SERIAL_CONSOLE = "115200 ${SERIAL_DEV}1"

PREFERRED_PROVIDER_virtual/bootloader = "bootloader-imx6d"

PREFERRED_PROVIDER_virtual/kernel = "linux-imx-rt"
PREFERRED_PROVIDER_libfslparser = "libfslparser"
PREFERRED_PROVIDER_libfslcodec = "libfslcodec"
PREFERRED_PROVIDER_libfslvpuwrap = "libfslvpuwrap"
PREFERRED_RPROVIDER_gst1.0-fsl-plugin = "gst1.0-fsl-plugin"

PREFERRED_VERSION_linux-imx-rt = "3.14.28"
#PREFERRED_VERSION_firmware-imx = "3.14.28-1.0.0"

PREFERRED_PROVIDER_virtual/wayland-egl = "imx-gpu-viv"
PREFERRED_VERSION_imx-gpu-viv = "5.0.11.p4.4-hfp"
PREFERRED_VERSION_xf86-video-imxfb-vivante = "5.0.11.p4.4"
PREFERRED_VERSION_xf86-video-imxfb = "11.09.01"
PREFERRED_VERSION_gstreamer1.0-plugins-imx = "0.11.1"

ACCEPT_FSL_EULA = "1"
MACHINE_USES_VIVANTE_KERNEL_DRIVER_MODULE = "0"

MACHINEOVERRIDES =. "usom03:"
```

## meta-exorint-enterprise/conf/machine/ns01-pa18.conf
```bitbake
#@NAME: Exor nSOM01 PA18
#@DESCRIPTION: Machine configuration for Panasonic nSOM01 based custom board

require include/nsom01.inc

PREFERRED_PROVIDER_virtual/kernel = "linux-fslc-mx6-rt"
PREFERRED_VERSION_linux-fslc-mx6-rt = "4.1%"

KERNEL_MACHINE = "imx6nsom"
KERNEL_DEVICETREE = "ns01-pa18.dtb"

MACHINEOVERRIDES =. "pa18:"
```

## meta-exorint-enterprise/conf/machine/ns01-x5xx.conf
```bitbake
#@NAME: Exor nSOM01 X5XX
#@DESCRIPTION: Machine configuration for Exor X5 nSOM01 based custom board

require include/nsom01.inc

PREFERRED_PROVIDER_virtual/kernel = "linux-fslc-mx6"
PREFERRED_VERSION_linux-fslc-mx6 = "4.9%"

KERNEL_MACHINE = "imx6nsom"
KERNEL_DEVICETREE = "ns01-x5.dtb ns01-x5bs.dtb"

MACHINEOVERRIDES =. "x5:"
```

## meta-exorint-enterprise/conf/machine/us01-au16.conf
```bitbake
#@NAME: Exor uSOM01 AU16
#@DESCRIPTION: Machine configuration for Carel uSOM01 based custom board

require include/usom01.inc

PREFERRED_PROVIDER_virtual/kernel = "linux"

UBOOT_MACHINE = "am335x_usom_config"
KERNEL_MACHINE = "am33xx_au"

MACHINEOVERRIDES =. "autec:au16:"
```

## meta-exorint-enterprise/conf/machine/us01-ca16.conf
```bitbake
#@NAME: Exor uSOM01 CA16
#@DESCRIPTION: Machine configuration for Carel uSOM01 based custom board

require include/usom01.inc

PREFERRED_PROVIDER_virtual/kernel = "linux"

UBOOT_MACHINE = "am335x_pgd_ca_config"
KERNEL_MACHINE = "am33xx_pgd_ca"

MACHINEOVERRIDES =. "carel:ca16:"
```

## meta-exorint-enterprise/conf/machine/us01-plcm.conf
```bitbake
#@NAME: Exor uSOM01 PLCM
#@DESCRIPTION: Machine configuration for the Exor uSOM01 based board

require include/usom01.inc

PREFERRED_PROVIDER_virtual/kernel = "linux"

UBOOT_MACHINE = "am335x_usom_config"
KERNEL_MACHINE = "am33xxusom"

MACHINEOVERRIDES =. "exor:plcm:"
```

## meta-exorint-enterprise/conf/machine/us01-wu16.conf
```bitbake
#@NAME: Exor uSOM01 WU16
#@DESCRIPTION: Machine configuration for Wueth uSOM01 based custom board

require include/usom01.inc

PREFERRED_PROVIDER_virtual/kernel = "linux"

UBOOT_MACHINE = "am335x_usom_wu16_config"
KERNEL_MACHINE = "am33xxusom_wu16fb"

MACHINEOVERRIDES =. "wuerth:wu16:"
```

## meta-exorint-enterprise/conf/machine/us02-hsxx.conf
```bitbake
#@NAME: Exor uSOM02 HSSX
#@DESCRIPTION: Machine configuration for the Exor uSOM02 based board

require include/usom02.inc

PREFERRED_PROVIDER_virtual/kernel = "linux"

UBOOT_MACHINE = "us02_etop_config"

KERNEL_MACHINE = "socfpgausom"
KERNEL_DEVICETREE = "usom_etop6xx.dtb"

MACHINEOVERRIDES =. "exor:hsxx:"
```

## meta-exorint-enterprise/conf/machine/us02-lj18.conf
```bitbake
#@NAME: Exor uSOM02 LJ18
#@DESCRIPTION: Machine configuration for the Exor uSOM02 based board

require include/usom02.inc

PREFERRED_PROVIDER_virtual/kernel = "linux"

UBOOT_MACHINE = "us02_etop_config"

KERNEL_MACHINE = "socfpgausom"
KERNEL_DEVICETREE = "usom_lju.dtb"

MACHINEOVERRIDES =. "exor:lj18:"
```

## meta-exorint-enterprise/conf/machine/us03-be15.conf
```bitbake
#@NAME: Exor uSOM03 BE15
#@DESCRIPTION: Machine configuration for Bekaert uSOM03 based custom board

require include/usom03.inc

PREFERRED_PROVIDER_virtual/kernel = "linux-fslc-mx6-rt"

KERNEL_MACHINE = "imx6usom"
KERNEL_DEVICETREE = "usom_be15a.dtb usom_be15b.dtb"

MACHINEOVERRIDES =. "exor:be15:"
```

## meta-exorint-enterprise/conf/machine/us03-be15c.conf
```bitbake
#@NAME: Exor uSOM03 BE15
#@DESCRIPTION: Machine configuration for Bekaert uSOM03 based custom board

require include/usom03.inc

PREFERRED_PROVIDER_virtual/kernel = "linux-fslc-mx6-rt"

KERNEL_MACHINE = "imx6be15"
KERNEL_DEVICETREE = "usom_be15a.dtb"

MACHINEOVERRIDES =. "bekaert:be15:"
```

## meta-exorint-enterprise/conf/machine/us03-hsxx.conf
```bitbake
#@NAME: Exor uSOM03 HSXX
#@DESCRIPTION: Machine configuration for Exor uSOM03 based custom

require include/usom03.inc

PREFERRED_PROVIDER_virtual/kernel = "linux-fslc-mx6-rt"

KERNEL_MACHINE = "imx6usom"
KERNEL_DEVICETREE = "usom_etop7xx.dtb usom_etop7xxq.dtb"

MACHINEOVERRIDES =. "exor:hsxx:"
```

## meta-exorint-enterprise/conf/machine/us03-jsxx.conf
```bitbake
#@NAME: Exor uSOM03 JSXX
#@DESCRIPTION: Machine configuration for Exor uSOM03 based custom

require include/usom03.inc

PREFERRED_PROVIDER_virtual/kernel = "linux-fslc-mx6-rt"

KERNEL_MACHINE = "imx6usom"
KERNEL_DEVICETREE = "usom_jsmart.dtb usom_jsmartq.dtb usom_jsmartttl.dtb"

MACHINEOVERRIDES =. "exor:jsxx:"
```

## meta-exorint-enterprise/conf/machine/us03-wu16.conf
```bitbake
#@NAME: Exor uSOM03 WU16
#@DESCRIPTION: Machine configuration for Wuerth uSOM03 based custom

require include/usom03.inc

PREFERRED_PROVIDER_virtual/kernel = "linux-fslc-mx6-rt"

KERNEL_MACHINE = "imx6wu16_fastboot"
KERNEL_DEVICETREE = "usom_wu16.dtb"

UBOOT_MACHINE = "mx6dl_usom_wu16_config"

MACHINEOVERRIDES =. "wuerth:wu16:"
```

## meta-exorint/conf/layer.conf
```bitbake
# We have a conf and classes directory, append to BBPATH
BBPATH .= ":${LAYERDIR}"

# We have a recipes directory, add to BBFILES
BBFILES += "${LAYERDIR}/recipes*/*/*.bb ${LAYERDIR}/recipes*/*/*.bbappend"

FSL_EULA_FILE = "${LAYERDIR}/conf/EULA"
ACCEPT_FSL_EULA = "1"
FSL_MIRROR ?= "http://www.freescale.com/lgfiles/NMG/MAD/YOCTO/"

BBFILE_COLLECTIONS += "meta-exorint"
BBFILE_PATTERN_meta-exorint := "^${LAYERDIR}/"
BBFILE_PRIORITY_meta-exorint = "8"

LICENSE_PATH += "${LAYERDIR}/licenses"
```

## meta-jml/conf/layer.conf
```bitbake
# We have a conf and classes directory, append to BBPATH
BBPATH .= ":${LAYERDIR}"

# We have a recipes directory, add to BBFILES
BBFILES += "${LAYERDIR}/recipes*/*/*.bb ${LAYERDIR}/recipes*/*/*.bbappend"

BBFILE_COLLECTIONS += "meta-jml"
BBFILE_PATTERN_meta-jml := "^${LAYERDIR}/"
BBFILE_PRIORITY_meta-jml = "9"
```
